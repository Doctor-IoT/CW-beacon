/**
 * @file    CWbeaconWeb.ino
 * @brief   IoT-controlled HF CW (Morse code) beacon for NodeMCU v2 (ESP8266)
 *
 * @version 1.32
 * @author  Dr. IoT — IoT Lab @ IIS Cassata Gattapone, Gubbio, Italy
 * @link    https://doctoriot.wordpress.com/beacon-cw-14-mhz-3w/
 *
 * ─────────────────────────────────────────────────────────────────────────────
 * DESCRIPTION
 * ─────────────────────────────────────────────────────────────────────────────
 * Firmware for a 14 MHz (20 m band) amateur radio CW beacon based on the
 * NodeMCU v2 development board (ESP8266). The beacon continuously transmits
 * a Morse code message that contains:
 *   - The station call sign  (e.g. IA/IU0SZS)
 *   - A free-text QTC field  (e.g. 130YR PB14QV)
 *   - A 4-character Fletcher-16 CRC authentication code
 *
 * The CRC is computed over the current UTC timestamp concatenated with a
 * fixed salt ("25041874" — Marconi's birthday, April 25, 1874). This allows
 * any receiving station that knows the salt to verify the time and authenticity
 * of each transmission independently.
 *
 * The RF carrier is generated by a Si5351A clock IC driven over I2C and is
 * gated on/off synchronously with the LED indicator to key the Morse signal.
 *
 * ─────────────────────────────────────────────────────────────────────────────
 * CONNECTIVITY FEATURES
 * ─────────────────────────────────────────────────────────────────────────────
 *   Wi-Fi        : STA mode with automatic fallback to AP mode (SSID: CWbeacon-AP)
 *   Web server   : Status page + full configuration at http://<device-ip>/
 *   OTA update   : Firmware update via browser at http://<device-ip>/update
 *   Telegram bot : Real-time control and status via 15 bot commands
 *   NTP          : Time synchronization from pool.ntp.org, UTC, hourly resync
 *   Serial       : Diagnostic console at 115200 baud
 *
 * ─────────────────────────────────────────────────────────────────────────────
 * HARDWARE REQUIREMENTS
 * ─────────────────────────────────────────────────────────────────────────────
 *   - NodeMCU v2 (ESP8266, 4 MB flash)
 *   - Si5351A breakout board (Etherkit or compatible)
 *   - RF power amplifier (~3 W on 14 MHz)
 *   - Low-pass filter (20 m band, 7-element Chebyshev)
 *   - Status LED on GPIO14 / D5
 *   - 5 V USB or regulated DC supply (~500 mA)
 *
 * ─────────────────────────────────────────────────────────────────────────────
 * WIRING (NodeMCU v2 pin labels / GPIO numbers)
 * ─────────────────────────────────────────────────────────────────────────────
 *   Si5351A SDA  → D2  / GPIO4
 *   Si5351A SCL  → D1  / GPIO5
 *   Status LED   → D5  / GPIO14  (anode via resistor to 3.3 V)
 *
 * ─────────────────────────────────────────────────────────────────────────────
 * REQUIRED LIBRARIES (install via Arduino Library Manager)
 * ─────────────────────────────────────────────────────────────────────────────
 *   ArduinoJson        — JSON parsing (used indirectly by AsyncTelegram2)
 *   AsyncTelegram2     — Telegram Bot API client over BearSSL/TLS
 *   ESP8266 Arduino    — Core SDK (ESP8266WiFi, WebServer, HTTPUpdateServer …)
 *   NTPClient          — Network Time Protocol client
 *   Si5351             — Etherkit Si5351 driver (local copy: si5351.h / si5351.cpp)
 *   UnixTime           — Unix timestamp → calendar fields decomposition
 *
 * ─────────────────────────────────────────────────────────────────────────────
 * REVISION HISTORY
 * ─────────────────────────────────────────────────────────────────────────────
 *   1.32  Fixed beacon STOP request; added /info command to Telegram bot
 *   1.31  Fixed empty Wi-Fi password bug
 *   1.3   Added Telegram commands: /setspd, /setqrz, /setqrg, /setcal, /setmsg
 *   1.2   Added Telegram bot integration
 *   1.1   Web-based configuration interface
 *   1.0   First operating version
 */

#define firmwareRev "CW Beacon Web 1.32"

// ─────────────────────────────────────────────────────────────────────────────
// LIBRARY INCLUDES
// ─────────────────────────────────────────────────────────────────────────────
#include <ArduinoJson.h>
#include <AsyncTelegram2.h>
#include <EEPROM.h>
#include <ESP.h>
#include <ESP8266WiFi.h>
#include <ESP8266HTTPUpdateServer.h>
#include <ESP8266mDNS.h>
#include <ESP8266WebServer.h>
#include "morse.h"      // Modified Morse sender — LEDMorseSender::setOn/setOff
                        // also enables/disables the Si5351A CLK0 output via I2C
#include <NTPClient.h>
#include "si5351.h"     // Local copy of the Etherkit Si5351 driver
#include <time.h>
#include <UnixTime.h>
#include <WiFiClientSecure.h>

// ─────────────────────────────────────────────────────────────────────────────
// TIMEZONE / NTP CONFIGURATION
// ─────────────────────────────────────────────────────────────────────────────
#define MYTZ "UTC0"                          // Time zone string — UTC (POSIX format)
//#define MYTZ "CET-1CEST,M3.5.0,M10.5.0/3"  // Alternate: Europe/Rome

// ─────────────────────────────────────────────────────────────────────────────
// GPIO AND TIMING CONSTANTS
// ─────────────────────────────────────────────────────────────────────────────
//#define LED 2           // Option: onboard LED on D4 / GPIO2 (active LOW on most modules)
#define LED 14            // Status LED on D5 / GPIO14 — blinks in sync with the RF carrier
#define TXPAUSE 15        // Gap (in seconds) between consecutive CW transmissions

// ─────────────────────────────────────────────────────────────────────────────
// Si5351A FREQUENCY SYNTHESIZER
// ─────────────────────────────────────────────────────────────────────────────
// The Si5351A is connected to the ESP8266 I2C bus:
//   SDA → GPIO4 (D2)  /  SCL → GPIO5 (D1)
// CLK0 output carries the RF carrier; CLK1 and CLK2 are unused.
Si5351 beacon;

/**
 * Frequency calibration offset in Hz (signed).
 * Compensates for the crystal reference tolerance on the Si5351A module.
 * Run the si5351_calibration example sketch once to determine your value,
 * then store it via the web interface or the /setcal Telegram command.
 */
int32_t cal_factor = 100;

/**
 * Target carrier frequency in hundredths of hertz (centi-hertz).
 * 1409695000 = 14,096,950.00 Hz = 14.09695 MHz
 * The Si5351 driver API uses this unit to allow sub-Hz resolution.
 * This value is overwritten at boot from EEPROM (or from the `qrg` string).
 */
uint64_t target_freq = 1409695000ULL;

// ─────────────────────────────────────────────────────────────────────────────
// BEACON MESSAGE FIELDS
// ─────────────────────────────────────────────────────────────────────────────
String qrg     = "";              // Carrier frequency as text string (Hz), stored in EEPROM
String cw_message = "";           // Full assembled CW message sent to the Morse library
String qrz     = "ia/iu0szs";    // Station call sign — must be lowercase for the Morse library
String message  = "130yr pb14qv"; // Free-text QTC payload (max 32 chars, stored in EEPROM)

/**
 * UTC timestamp string used as the first input to the CRC function.
 * Format: "yymmddhhmm" (10 characters, zero-padded).
 * Updated from NTP before each transmission in SetBeaconMsg().
 * Default value is a placeholder used before the first NTP sync.
 */
String timeStamp = "2414101700";

/**
 * CRC salt — Marconi's birthday: April 25, 1874.
 * The Fletcher-16 checksum is computed over (timeStamp + salt).
 * Any receiving station that knows this salt and the current UTC time
 * can independently verify the 4-hex CRC appended to each transmission,
 * confirming the beacon's identity and timing.
 */
String salt = "25041874";

// ─────────────────────────────────────────────────────────────────────────────
// MORSE SENDER
// ─────────────────────────────────────────────────────────────────────────────
// NUM_SPEEDS: number of speed steps to cycle through between transmissions.
// Only one speed is active (index 0); the array size is kept for extensibility.
#define NUM_SPEEDS  1
// wpms[0] = active WPM rate (loaded from EEPROM at boot; default 12 WPM)
// wpms[1] = unused slot (kept for array-size compatibility with speedIndex logic)
float wpms[] = {12.0, 0.0};

/**
 * LEDMorseSender is a subclass of MorseSender defined in morse.h / morse.cpp.
 * Its setOn() and setOff() methods simultaneously:
 *   1. Drive the LED GPIO high/low for a visual indicator.
 *   2. Call beacon.output_enable(SI5351_CLK0, 1/0) to gate the RF carrier.
 * This gives perfectly synchronized visual and RF keying.
 */
LEDMorseSender cwtx(LED, wpms[0]);

unsigned int speedIndex = 100;    // Initialized out-of-range; wraps to 0 on first use

// ─────────────────────────────────────────────────────────────────────────────
// TELEGRAM BOT
// ─────────────────────────────────────────────────────────────────────────────
// The bot connects over BearSSL/TLS (port 443) using the Telegram Bot API.
// The certificate trust anchor is provided by the AsyncTelegram2 library.
BearSSL::WiFiClientSecure clientBot;
BearSSL::Session   session;
BearSSL::X509List  certificate(telegram_cert);  // telegram_cert defined in AsyncTelegram2
AsyncTelegram2 myBot(clientBot);

/** Telegram Bot API token — replace with your own bot token from @BotFather. */
String token = "0000000000:00000000000000000000000000000000000";

TBMessage msg;  // Holds the most recently received Telegram message

// ─────────────────────────────────────────────────────────────────────────────
// EEPROM LAYOUT
// ─────────────────────────────────────────────────────────────────────────────
// The ESP8266 emulates EEPROM on SPI flash (512 bytes). All persistent
// configuration is stored here and loaded at boot by varPreset().
// Each parameter occupies a fixed address range (Adr) of fixed length (Len).
//
// +--------+-----+-----+-----------------------------------------------+
// | Name   | Adr | Len | Contents                                       |
// +--------+-----+-----+-----------------------------------------------+
// | admPwd |   0 |  16 | Admin password (web UI protection)             |
// | netMod |  16 |   1 | Network mode flags (reserved)                  |
// | sensEn |  17 |   1 | Feature enable bits (bit0 = Telegram bot)      |
// | pwdChg |  18 |   1 | '1' if admin password has been changed         |
// | httpsE |  19 |   1 | HTTPS flag (reserved)                          |
// | bgcol  |  24 |   8 | HTML background color (#RRGGBB)                |
// | APpwd  |  32 |  32 | Wi-Fi network password (STA mode)              |
// | sysNam |  64 |  16 | System name shown in the web UI title          |
// | APssid |  80 |  24 | Wi-Fi network SSID (STA mode)                  |
// | message| 104 |  32 | Beacon QTC text field                          |
// | qrz    | 136 |  16 | Station call sign                              |
// | qrg    | 152 |  16 | Carrier frequency string (Hz)                  |
// | an2txt | 168 |  16 | Reserved                                       |
// | getScp | 184 |  24 | Reserved (was: HTTP GET script path)           |
// | getPer | 208 |   4 | Reserved (was: HTTP GET period)                |
// | getPIP | 212 |  24 | Reserved (was: public IP request URL)          |
// | fcal   | 236 |   4 | Frequency calibration factor (signed integer)  |
// | wpm    | 240 |   4 | Morse speed in WPM (float stored as text)      |
// | spare  | 244 |   8 | Reserved for future use                        |
// | tgTemp | 252 |   4 | Reserved                                       |
// | staIP  | 256 |   4 | Static IPv4 address (4 bytes, 0.0.0.0 = DHCP) |
// | gwIP   | 260 |   4 | Default gateway IPv4                           |
// | netMsk | 264 |   4 | Subnet mask IPv4                               |
// | dns0   | 268 |   4 | Primary DNS IPv4                               |
// | dns1   | 272 |   4 | Secondary DNS IPv4                             |
// | user0  | 276 |   8 | Telegram admin user ID (uint64, big-endian)    |
// | user1  | 284 |   8 | Telegram allowed user 1 ID                     |
// | user2  | 292 |   8 | Telegram allowed user 2 ID                     |
// | user3  | 300 |   8 | Telegram allowed user 3 ID                     |
// | token  | 308 |  46 | Telegram Bot API token                         |
// +--------+-----+-----+-----------------------------------------------+
#define EEmemLen        512
#define admPwdAdr         0
#define admPwdLen        16
#define networkModeAdr   16
#define networkModeLen    1
#define sensorsEnableAdr 17
#define sensorsEnableLen  1
#define pwdChangedAdr    18
#define pwdChangedLen     1
#define httpsEnableAdr   19
#define httpsEnableLen    1
#define bgcolorAdr       24
#define bgcolorLen        8
#define APpwdAdr         32
#define APpwdLen         32
#define sysNameAdr       64
#define sysNameLen       16
#define APssidAdr        80
#define APssidLen        24
#define messageAdr      104
#define messageLen       32
#define qrzAdr          136
#define qrzLen           16
#define qrgAdr          152
#define qrgLen           16
#define an2textAdr      168
#define an2textLen       16
#define getScriptAdr    184
#define getScriptLen     24
#define getPeriodAdr    208
#define getPeriodLen      4
#define getPublicIpAdr  212
#define getPublicIpLen   24
#define fcalAdr         236
#define fcalLen           4
#define wpmAdr          240
#define wpmLen            4
#define spareAdr        244
#define spareLen          8
#define targetTempAdr   252
#define targetTempLen     4
#define staticIpAdr     256
#define staticIpLen       4
#define gatewayIpAdr    260
#define gatewayIpLen      4
#define netMaskAdr      264
#define netMaskLen        4
#define dnsIp0Adr       268
#define dnsIp0Len         4
#define dnsIp1Adr       272
#define dnsIp1Len         4
#define user0Adr        276
#define user0Len          8
#define user1Adr        284
#define user1Len          8
#define user2Adr        292
#define user2Len          8
#define user3Adr        300
#define user3Len          8
#define tokenAdr        308
#define tokenLen         46

// ─────────────────────────────────────────────────────────────────────────────
// GLOBAL VARIABLES
// ─────────────────────────────────────────────────────────────────────────────
bool ADMIN            = false;  // True when admin mode is active via serial console
bool APmodeON         = 0;      // True when the device is running as a Wi-Fi Access Point
bool BeaconON         = 1;      // Beacon transmit enable flag (1 = ON, 0 = OFF)
bool morseInProgress  = false;  // True while a Morse message is being transmitted
bool restartReq       = false;  // Set to true to request an ESP.restart() after Telegram flush
bool TGbotEnable      = false;  // True when the Telegram bot is enabled (EEPROM bit)

char pwdChanged;                // Byte read from EEPROM: '1' if the admin password was changed

unsigned int countdown2tx   = 0;    // Countdown timer (seconds) for the inter-transmission gap

unsigned long lastSampleData;
unsigned long timeSample;

/**
 * Array of authorized Telegram user IDs (uint64_t).
 * userid[0] is the admin user; userid[1..3] are additional allowed users.
 * Each user's numeric ID can be found with the @JsonDumpBot bot at https://t.me/JsonDumpBot
 */
uint64_t userid[4];
uint64_t sender;    // Telegram chat ID of the message sender currently being processed

String RxDataSer    = "";          // Serial console receive buffer
String adminpwd     = "12345678"; // Admin password for the web setup page (default: "12345678")
String bgcolor      = "";          // HTML background color (#RRGGBB), e.g. "#1e73be"
String sysName      = "012345678901234"; // Device name shown in the web page title
String getServer    = "";          // Reserved
String getScript    = "";          // Reserved
String getPIPscr    = "";          // Reserved
String admpwd;                     // Temporary: admin password received from the web form
String sysname;                    // Temporary: system name received from the web form

// Access Point credentials used when the device cannot join a Wi-Fi network
String APssid    = "CWbeacon-AP"; // Fallback AP SSID
String APpwd     = "CWbeacon-AP"; // Fallback AP password
int    apChannel = 1;             // Fallback AP Wi-Fi channel

long rssi; // Last measured Wi-Fi RSSI in dBm

// NTP client parameters
long utcOffsetInSeconds  = 0;          // UTC offset (0 = UTC, 3600 = UTC+1 …)
long ntpUpdateInterval   = 3600000;    // NTP resynchronization interval: 1 hour (ms)
char daysOfTheWeek[7][12] = {
  "Sunday", "Monday", "Tuesday", "Wednesday", "Thursday", "Friday", "Saturday"
};
time_t   epochTime;   // Current Unix epoch time (seconds since 1970-01-01 00:00 UTC)
UnixTime stamp(0);    // Decomposes epoch into year/month/day/hour/minute/second fields

// (HTTP/HTTPS client objects removed — outbound GET feature not active)

// ─────────────────────────────────────────────────────────────────────────────
// WEB SERVER
// ─────────────────────────────────────────────────────────────────────────────
// The built-in HTTP server listens on port 80.
// Routes:
//   /                → Status page (handle_OnConnect)
//   /setup           → Configuration form (handle_setup)
//   /applysettings   → Form POST handler — saves settings to EEPROM (handle_applysettings)
//   /restart         → Reboot endpoint (handle_restart)
//   /update          → OTA firmware update (ESP8266HTTPUpdateServer, password-protected)
ESP8266WebServer server(80);
ESP8266HTTPUpdateServer httpUpdater;

// NTP client — server, UTC offset, resync interval
WiFiUDP ntpUDP;
NTPClient timeClient(ntpUDP, "pool.ntp.org", utcOffsetInSeconds, ntpUpdateInterval);

// Wi-Fi credentials loaded from EEPROM at boot; also set via serial console or web UI
String wifissid      = "";         // Wi-Fi network SSID (STA mode)
String wifipwd       = "";         // Wi-Fi network password (STA mode)

// Static IP configuration — loaded from EEPROM; 0.0.0.0 means DHCP
IPAddress local_IP(0, 0, 0, 0);
IPAddress gateway(0, 0, 0, 0);
IPAddress subnet(0, 0, 0, 0);
IPAddress primaryDNS(0, 0, 0, 0);
IPAddress secondaryDNS(0, 0, 0, 0);

// ─────────────────────────────────────────────────────────────────────────────
// FUNCTION FORWARD DECLARATIONS
// ─────────────────────────────────────────────────────────────────────────────
String   u64ToString(uint64_t value);
uint64_t Str2u64(String text);
void     handleBotMessages(void);
void     handle_applysettings(void);
void     handle_OnConnect(void);
void     handle_NotFound(void);
void     handle_restart(void);
void     handle_setup(void);
void     ProcessRxDataSer(void);
void     saveByte2eeprom(unsigned char val, int address);
void     saveString2eeprom(String str2Write, int startAdr, int strLen);
void     saveU64eeprom(uint64_t val, unsigned int startAdr);
void     SendHTMLchunked(uint8_t textNumber);
void     SetBeaconMsg(void);
void     varPreset(void);
void     wifiConnection(void);
uint16_t checksumCalculator(uint8_t * data, uint16_t length);


// ═════════════════════════════════════════════════════════════════════════════
// SETUP
// ═════════════════════════════════════════════════════════════════════════════
void setup() {
  restartReq = 0;

  // Configure the status LED / RF key line as a digital output
  pinMode(LED, OUTPUT);

  Serial.begin(115200);
  Serial.println("");

  // Flush any bytes that may have arrived in the serial buffer during boot
  while (Serial.available() > 0) {
    Serial.read();
  }

  RxDataSer.reserve(32); // Pre-allocate serial receive buffer to avoid heap fragmentation

  Serial.println(firmwareRev);

  // Print the cause of the last reset to help diagnose unexpected reboots
  rst_info *resetInfo;
  resetInfo = ESP.getResetInfoPtr();
  Serial.print("Reset reason: ");
  Serial.println(resetInfo->reason);

  varPreset();       // Load all configuration from EEPROM into RAM variables
  wifiConnection();  // Connect to Wi-Fi in STA mode (or start AP if STA fails)

  // NTP and Telegram are only initialized when running in STA (connected) mode.
  // In AP mode neither NTP nor Telegram can reach the internet.
  if (APmodeON == 0) {
    // Start the NTP client and perform the first time synchronization
    timeClient.begin();
    timeClient.update();

    // Synchronize the system clock so BearSSL can validate the Telegram TLS certificate.
    // configTime() uses POSIX timezone strings and multiple NTP server fallbacks.
    configTime(MYTZ, "time.google.com", "time.windows.com", "pool.ntp.org");

    // Configure BearSSL session resumption and certificate trust for the Telegram bot
    clientBot.setSession(&session);
    clientBot.setTrustAnchors(&certificate);
    clientBot.setBufferSizes(1024, 1024);

    if (TGbotEnable == true) {
      myBot.setUpdateTime(5000);  // Poll Telegram servers every 5 seconds
      const char* secretToken = token.c_str();
      myBot.setTelegramToken(secretToken);

      Serial.print("\nTest Telegram connection... ");
      myBot.begin() ? Serial.println("OK") : Serial.println("NOK");

      Serial.print("Bot name: @");
      Serial.println(myBot.getBotName());

      // Notify the admin user that the bot has (re)started
      if (userid[0] > 10000) {
        myBot.sendTo(userid[0], "Bot started!");
      }
    }

    // Compose the initial beacon message and initialize the Si5351A
    if (BeaconON) {
      SetBeaconMsg();
    }
  }
}


// ═════════════════════════════════════════════════════════════════════════════
// MAIN LOOP
// ═════════════════════════════════════════════════════════════════════════════
void loop() {
  // ── NON-BLOCKING MORSE SENDER ────────────────────────────────────────────
  // continueSending() checks millis() internally and toggles the LED / Si5351A
  // output as needed. It must be called as often as possible (every few ms) to
  // produce a clean, accurate Morse fist. It returns false when the complete
  // message has been sent.
  if (APmodeON == 0) {
    if (BeaconON == 1) {    // Beacon is enabled — transmit
      if (!cwtx.continueSending()) {   // Current message finished
        if (morseInProgress == 1) {
          countdown2tx = TXPAUSE;  // Start the inter-transmission gap countdown
          morseInProgress = 0;
        }
        if (countdown2tx == 0) {
          // Advance to the next speed step (cycles through wpms[] array)
          if (++speedIndex >= NUM_SPEEDS) {
            speedIndex = 0;
            SetBeaconMsg();     // Recompose message with updated CRC and re-init Si5351A
          }
          cwtx.setWPM(wpms[speedIndex]);
          cwtx.startSending(); // Begin sending from the first character of the message
        }
      }
      else {    // Morse transmission is still in progress
        morseInProgress = 1;
      }
    }
    else {      // Beacon is disabled — ensure the RF carrier and LED are off
      if (morseInProgress == 1) {
        digitalWrite(LED, LOW);
        beacon.output_enable(SI5351_CLK0, 0);
        morseInProgress = 0;
      }
    }
  }

  // ── HTTP SERVER ──────────────────────────────────────────────────────────
  server.handleClient(); // Process any pending HTTP requests from browser clients

  // ── 1-SECOND TICK ───────────────────────────────────────────────────────
  timeSample = millis();
  if ((timeSample - lastSampleData) >= 1000) {
    // Decrement the inter-transmission gap countdown (stops at 0)
    if (countdown2tx > 0) {
      countdown2tx--;
    }

    rssi = WiFi.RSSI(); // Refresh the RSSI reading once per second

    lastSampleData += 1000;

    if (APmodeON == 0) {
      // Keep the NTP time synchronized (the library resyncs automatically
      // based on ntpUpdateInterval; this call is essentially a no-op most ticks)
      timeClient.update();
      epochTime = timeClient.getEpochTime();

      // Process incoming Telegram messages (if the bot is enabled and connected)
      if (TGbotEnable) {
        if (WiFi.status() == WL_CONNECTED) {
          handleBotMessages();
        }
      }

      // Deferred restart: wait until there is no pending Telegram reply,
      // then reboot (triggered by the /reboot Telegram command)
      if (restartReq == 1) {
        if (myBot.noNewMessage()) {
          restartReq = 0;
          ESP.restart();
        }
      }


    }
  }

  // ── SERIAL CONSOLE ───────────────────────────────────────────────────────
  // Accumulate incoming serial bytes into RxDataSer; process when newline received
  while (Serial.available()) {
    char b = Serial.read();
    RxDataSer += b;
    if (b == '\n') {
      ProcessRxDataSer();
      RxDataSer = "";
    }
  }
}


// ═════════════════════════════════════════════════════════════════════════════
// TELEGRAM BOT MESSAGE HANDLER
// ═════════════════════════════════════════════════════════════════════════════
/**
 * @brief Process one incoming Telegram message (if any).
 *
 * Called once per second from loop(). Checks for a new message, validates
 * the sender's user ID against the authorized list, and dispatches the
 * appropriate command.
 *
 * Supported commands:
 *   /help      — Print all available commands
 *   /stat      — Beacon status: message, frequency, speed, uptime, RSSI, IP
 *   /beaconon  — Enable the RF transmitter
 *   /beaconoff — Disable the RF transmitter
 *   /getqrg    — Report the current carrier frequency (Hz)
 *   /getcal    — Report the current frequency calibration factor
 *   /getmsg    — Report the current QTC text payload
 *   /getqrz    — Report the current call sign
 *   /getspd    — Report the current Morse speed (WPM)
 *   /info      — Report the firmware revision string
 *   /reboot    — Request a graceful reboot
 *   /setqrg N  — Set carrier frequency to N Hz (saves to EEPROM)
 *   /setcal N  — Set frequency calibration factor to N (saves to EEPROM)
 *   /setmsg T  — Set the QTC text to T (max 32 chars, saves to EEPROM)
 *   /setqrz C  — Set the call sign to C (max 16 chars, saves to EEPROM)
 *   /setspd W  — Set the Morse speed to W WPM (0 < W ≤ 30, saves to EEPROM)
 */
void handleBotMessages(void)
{
  if (myBot.getNewMessage(msg)) {
    sender = msg.chatId;  // Numeric user ID of the message sender

    // Authorize: only pre-configured user IDs may send commands
    if (userid[0] == sender || userid[1] == sender ||
        userid[2] == sender || userid[3] == sender)
    {
      String msgText = msg.text;
      String reply;

      if (msgText.equals("/help")) {
        reply  = "Available commands:";
        reply += "\n/beaconon\tBeacon ON";
        reply += "\n/beaconoff\tBeacon OFF";
        reply += "\n/getqrg\tQRG of the beacon";
        reply += "\n/getcal\tQRG Calibration factor";
        reply += "\n/getmsg\tQTC of the beacon";
        reply += "\n/getqrz\tQRZ of the beacon";
        reply += "\n/getspd\tWord per minute";
        reply += "\n/info\tFirmware info";
        reply += "\n/reboot\tSystem restart";
        reply += "\n/setqrg\tSet the QRG of the beacon";
        reply += "\n/setcal\tSet the QRG calibration factor";
        reply += "\n/setmsg\tSet the QTC, max 32 chars";
        reply += "\n/setqrz\tSet the QRZ, max 16 chars";
        reply += "\n/setspd\tWord per minute";
        reply += "\n/stat\tStatus of the beacon";
        myBot.sendMessage(msg, reply);
      }

      else if (msgText.equals("/stat")) {
        // Decompose uptime (ms) into days, hours, minutes, seconds
        unsigned long uptime      = millis() / 1000;
        unsigned char uptimeDays    = uptime / 86400;
        unsigned char uptimeHours   = (uptime % 86400) / 3600;
        unsigned char uptimeMinutes = (uptime % 3600) / 60;
        unsigned char uptimeSeconds = uptime % 60;
        reply  = "Beacon message = " + cw_message + "\n";
        reply += "Beacon QRG = "     + qrg        + "\n";
        reply += "Beacon speed = "   + String(wpms[speedIndex]) + " wpm\n";
        reply += "Beacon is ";
        reply += (BeaconON) ? "ON\n" : "OFF\n";
        reply += "WiFi RSSI = "  + String(rssi) + "dBm\n";
        reply += "MAC Adr = "    + WiFi.macAddress() + "\n";
        reply += "Local IP = "   + WiFi.localIP().toString() + "\n";
        reply += "Uptime dd:hh:mm:ss = " +
                 String(uptimeDays)    + ":" +
                 String(uptimeHours)   + ":" +
                 String(uptimeMinutes) + ":" +
                 String(uptimeSeconds) + "\n";
        myBot.sendMessage(msg, reply);
      }

      else if (msgText.equals("/beaconon")) {
        BeaconON = 1;
        myBot.sendMessage(msg, "The beacon is now ON");
      }

      else if (msgText.equals("/beaconoff")) {
        BeaconON = 0;
        myBot.sendMessage(msg, "The beacon is now OFF");
      }

      else if (msgText.equals("/getqrg")) {
        reply = "The beacon QRG is: " + qrg + " Hz";
        myBot.sendMessage(msg, reply);
      }

      else if (msgText.equals("/getcal")) {
        reply = "The QRG cal. factor is: " + String(cal_factor);
        myBot.sendMessage(msg, reply);
      }

      else if (msgText.equals("/getmsg")) {
        reply = "The beacon QTC is: " + message;
        myBot.sendMessage(msg, reply);
      }

      else if (msgText.equals("/getqrz")) {
        reply = "The QRZ is: " + qrz;
        myBot.sendMessage(msg, reply);
      }

      else if (msgText.equals("/getspd")) {
        reply = "Word per minute: " + String(wpms[0]);
        myBot.sendMessage(msg, reply);
      }

      else if (msgText.equals("/info")) {
        reply = firmwareRev;
        myBot.sendMessage(msg, reply);
      }

      else if (msgText.equals("/reboot")) {
        myBot.sendMessage(msg, "Rebooting..");
        restartReq = 1;  // Defer reboot until the reply has been sent
      }

      else if (msgText.startsWith("/setqrg")) {
        // Extract the frequency value from the command (characters after "/setqrg")
        qrg = msgText.substring(7);
        target_freq = Str2u64(qrg) * 100;  // Convert Hz → centi-Hz for Si5351 API
        saveString2eeprom(qrg, qrgAdr, qrgLen);
        reply = "The new beacon QRG is: " + qrg;
        myBot.sendMessage(msg, reply);
      }

      else if (msgText.startsWith("/setcal")) {
        String fcal = msgText.substring(7);
        long temp = fcal.toInt();
        // Accept only calibration values within a reasonable range
        if (-10000 < temp && temp < 10000) {
          cal_factor = temp;
          saveString2eeprom(fcal, fcalAdr, fcalLen);
        }
        else {
          fcal = String(cal_factor);  // Reject out-of-range value; echo the current one
        }
        reply = "The QRG cal. factor is: " + fcal;
        myBot.sendMessage(msg, reply);
      }

      else if (msgText.startsWith("/setmsg")) {
        // Extract the new QTC payload (characters after "/setmsg")
        message = msgText.substring(7);
        saveString2eeprom(message, messageAdr, messageLen);
        reply = "The new beacon QTC is: " + message;
        myBot.sendMessage(msg, reply);
      }

      else if (msgText.startsWith("/setqrz")) {
        qrz = msgText.substring(7);
        saveString2eeprom(qrz, qrzAdr, qrzLen);
        reply = "The new QRZ is: " + qrz;
        myBot.sendMessage(msg, reply);
      }

      else if (msgText.startsWith("/setspd")) {
        String temp  = msgText.substring(7);
        float  temp1 = temp.toFloat();
        // Accept only positive WPM values up to 30 WPM
        if (temp1 > 0 && temp1 <= 30) {
          wpms[0] = temp1;
          saveString2eeprom(temp, wpmAdr, wpmLen);
        }
        reply = "The new wpm is: " + temp;
        myBot.sendMessage(msg, reply);
      }

      else {
        // Unrecognized command — welcome message with help hint
        reply  = "Welcome ";
        reply += msg.sender.username;
        reply += ".\nTry /help for the list of the commands.";
        myBot.sendMessage(msg, reply);
      }
    }
    else
    {
      // Message from an unauthorized sender — alert the admin user
      myBot.sendTo(userid[0], "Not allowed user: " + String(sender));
    }
  }

  // Pet the watchdog timer after processing Telegram to prevent resets
  // during the blocking TLS handshake that may occur on getNewMessage()
  ESP.wdtEnable(1000);
  ESP.wdtFeed();
}


// ═════════════════════════════════════════════════════════════════════════════
// SERIAL CONSOLE COMMAND PROCESSOR
// ═════════════════════════════════════════════════════════════════════════════
/**
 * @brief Process a complete line received on the serial port (115200 baud).
 *
 * Commands (type at least the first 3 characters; commands end with Enter):
 *   adm     — Toggle admin mode ON/OFF (admin mode echoes debug data)
 *   hel     — Print the list of available commands
 *   inf     — Print firmware version, network info, and chip diagnostics
 *   pwdres  — Reset the admin password to "12345678" and reboot
 *   res     — Restart the ESP8266 immediately
 *   seta<P> — Set the admin password to P (in RAM only, not persisted)
 *   setn<N> — Set and persist the system name to N
 *   setp<P> — Set and persist the Wi-Fi password to P
 *   sets<S> — Set and persist the Wi-Fi SSID to S
 *   set?    — Print current system name, SSID, and password
 */
void ProcessRxDataSer(void)
{
  switch (RxDataSer[0])
  {
    // ── adm: toggle admin mode ────────────────────────────────────────────
    case 'a':
      if (RxDataSer[1] == 'd' && RxDataSer[2] == 'm') {
        ADMIN = !ADMIN;  // Toggle admin mode
      }
      break;

    // ── hel: print command list ───────────────────────────────────────────
    case 'h':
      if (RxDataSer[1] == 'e' && RxDataSer[2] == 'l') {
        Serial.println("Available commands");
        Serial.println("\tadm\tAdmin/user mode");
        Serial.println("\tinf\tSend information about the system");
        Serial.println("\tpwdres\tReset admin password");
        Serial.println("\tres\tRestart the system");
        Serial.println("\tseta\tSet admin password");
        Serial.println("\tsetn\tSet the name of the system");
        Serial.println("\tsetp\tSet the password for the AP");
        Serial.println("\tsets\tSet the SSID of the AP");
        Serial.println("\tset?\tPrint name, password and SSID");
      }
      break;

    // ── inf: print system information ────────────────────────────────────
    case 'i':
      if (RxDataSer[1] == 'n' && RxDataSer[2] == 'f') {
        Serial.println(firmwareRev);
        Serial.print("Sys name: ");    Serial.println(sysName);
        Serial.print("AP SSID: ");     Serial.println(wifissid);
        Serial.print("AP PWD: ");      Serial.println(wifipwd);
        Serial.print("WiFi IP: ");     Serial.println(WiFi.localIP());
        Serial.print("MAC: ");         Serial.println(WiFi.macAddress());
        Serial.print("RSSI:");         Serial.print(rssi); Serial.println(" dBm");
        Serial.print("Stations connected to soft-AP = ");
        Serial.println(WiFi.softAPgetStationNum());
        Serial.print("Soft-AP IP address = ");
        Serial.println(WiFi.softAPIP());
        WiFi.printDiag(Serial);
        Serial.print("getServer: ");   Serial.println(getServer);
        Serial.print("getScript: ");   Serial.println(getScript);
        Serial.print("getPIPscr: ");   Serial.println(getPIPscr);
        // ESP8266 chip and flash diagnostics
        Serial.print("Chip ID: ");
        Serial.println(ESP.getChipId());
        Serial.print("FLASH Chip ID: ");
        Serial.println(ESP.getFlashChipId(), HEX);
        Serial.print("FLASH size B: ");
        Serial.println(ESP.getFlashChipSize());
        Serial.print("FLASH real size B: ");
        Serial.println(ESP.getFlashChipRealSize());
        Serial.print("FLASH Hz: ");
        Serial.println(ESP.getFlashChipSpeed());
        Serial.print("Sketch size x 32-bit: ");
        Serial.println(ESP.getSketchSize());
        Serial.print("Free sketch size x 32-bit: ");
        Serial.println(ESP.getFreeSketchSpace());
        Serial.print("Free heap: ");
        Serial.println(ESP.getFreeHeap());
        Serial.print("Core ver.: ");
        Serial.println(ESP.getCoreVersion());
        Serial.print("CPU MHz: ");
        Serial.println(ESP.getCpuFreqMHz());
      }
      break;

    // ── pwdres: reset admin password to factory default ──────────────────
    case 'p':
      if (RxDataSer[1] == 'w' && RxDataSer[2] == 'd' &&
          RxDataSer[3] == 'r' && RxDataSer[4] == 'e' && RxDataSer[5] == 's') {
        // Write '0' to the pwdChanged flag so varPreset() will use the default password
        EEPROM.begin(EEmemLen);
        EEPROM.write(pwdChangedAdr, '0');
        EEPROM.end();
        Serial.println("Admin password reset\nReboot..");
        delay(100);
        ESP.reset();
      }
      break;

    // ── res: restart the system ───────────────────────────────────────────
    case 'r':
      if (RxDataSer[1] == 'e' && RxDataSer[2] == 's') {
        ESP.reset();
      }
      break;

    // ── set*: set various persistent or RAM parameters ────────────────────
    case 's':
      if (RxDataSer[1] == 'e' && RxDataSer[2] == 't') {
        if (RxDataSer[3] == 'a') {
          // seta<P>: set the admin password in RAM (not written to EEPROM)
          adminpwd = "";
          char i = 0;
          while (i < 32) {
            adminpwd += RxDataSer[4 + i];
            i++;
            if (RxDataSer[4 + i] == '\n' || RxDataSer[4 + i] == '\r') break;
          }
          Serial.print("Admin PWD: "); Serial.println(adminpwd);
        }
        else if (RxDataSer[3] == 'n') {
          // setn<N>: set and persist the system name
          int i = 0;
          EEPROM.begin(EEmemLen);
          sysName = "";
          while (RxDataSer[4 + i] != '\r') {
            EEPROM.write(sysNameAdr + i, RxDataSer[4 + i]);
            sysName += RxDataSer[4 + i];
            i++;
          }
          // Pad the remaining EEPROM slots with null bytes
          while (i < sysNameLen) {
            EEPROM.write(sysNameAdr + i, 0);
            i++;
          }
          EEPROM.end();
          Serial.print("SysName: "); Serial.println(sysName);
        }
        else if (RxDataSer[3] == 'p') {
          // setp<P>: set and persist the Wi-Fi password
          int i = 0;
          EEPROM.begin(EEmemLen);
          wifipwd = "";
          while (RxDataSer[4 + i] != '\r') {
            EEPROM.write(APpwdAdr + i, RxDataSer[4 + i]);
            wifipwd += RxDataSer[4 + i];
            i++;
          }
          while (i < APpwdLen) {
            EEPROM.write(APpwdAdr + i, 0);
            i++;
          }
          EEPROM.end();
          Serial.print("WiFi pwd: "); Serial.println(wifipwd);
        }
        else if (RxDataSer[3] == 's') {
          // sets<S>: set and persist the Wi-Fi SSID
          int i = 0;
          EEPROM.begin(EEmemLen);
          wifissid = "";
          while (RxDataSer[4 + i] != '\r') {
            EEPROM.write(APssidAdr + i, RxDataSer[4 + i]);
            wifissid += RxDataSer[4 + i];
            i++;
          }
          while (i < APssidLen) {
            EEPROM.write(APssidAdr + i, 0);
            i++;
          }
          EEPROM.end();
          Serial.print("WiFi SSID: "); Serial.println(wifissid);
        }
        else if (RxDataSer[3] == '?') {
          // set?: print name, SSID, and password
          Serial.print("Sys name: "); Serial.println(sysName);
          Serial.print("AP SSID: ");  Serial.println(wifissid);
          Serial.print("AP PWD: ");   Serial.println(wifipwd);
        }
      }
      break;

    default:
      Serial.println("?? Type \"hel\" for HELP");
      break;
  }
  Serial.println("");
}


// ═════════════════════════════════════════════════════════════════════════════
// BEACON MESSAGE SETUP
// ═════════════════════════════════════════════════════════════════════════════
/**
 * @brief Compose the CW message and (re)initialize the Si5351A synthesizer.
 *
 * This function is called at startup and at the beginning of each transmission
 * cycle. It:
 *   1. Reads the current UTC time from the NTP client.
 *   2. Builds a 10-character timestamp string: "yymmddhhmm".
 *   3. Computes a Fletcher-16 CRC over (timeStamp + salt).
 *   4. Assembles the full CW message: "<qrz> <message> <CRC-hex>".
 *   5. Passes the message to the LEDMorseSender object.
 *   6. Initializes the Si5351A PLL and sets the CLK0 output to target_freq.
 *
 * Example CW message: "ia/iu0szs 130yr pb14qv a3c2"
 *   where "a3c2" is the 4-hex CRC for the current minute and the Marconi salt.
 */
void SetBeaconMsg(void) {
  if (timeClient.isTimeSet()) {
    epochTime = timeClient.getEpochTime();
    stamp.getDateTime(epochTime);
    // Build "yymmddhhmm" — note: stamp.year includes the century, take the last 2 digits
    timeStamp = (String)stamp.year  +
                (String)stamp.month +
                (String)stamp.day   +
                (String)stamp.hour  +
                (String)stamp.minute;
  }

  // Compute Fletcher-16 checksum over "yymmddhhmm" + "25041874"
  // (22 characters total: 10 from the timestamp + 8 from the salt, null-terminated)
  char str[23];
  (timeStamp + salt).toCharArray(str, 22);
  uint16_t crc = checksumCalculator((uint8_t *)str, 22);

  Serial.print(timeStamp + salt + " ");
  Serial.println(crc, HEX);

  // Format the CRC as 4 zero-padded lowercase hex characters.
  // Buffer is 5 bytes: 4 hex digits + null terminator required by sprintf.
  char crcHex[5];
  sprintf(crcHex, "%04x", crc);

  // Assemble the full beacon message (all lowercase — required by the Morse library)
  cw_message = qrz + " " + message + " " + crcHex;
  Serial.println(cw_message);

  // Pass the assembled message to the LEDMorseSender
  cwtx.setup();
  cwtx.setMessage(cw_message);

  // Re-initialize the Si5351A for each transmission cycle.
  // This ensures the clock generator is in a defined state even after a
  // /setqrg or /setcal command was received since the last cycle.
  target_freq = Str2u64(qrg) * 100;  // Convert Hz → centi-Hz
  beacon.init(SI5351_CRYSTAL_LOAD_8PF, 0, 0);  // 8 pF crystal load, internal reference
  delay(5);
  beacon.set_correction(cal_factor, SI5351_PLL_INPUT_XO);  // Apply frequency correction
  delay(5);
  beacon.set_pll(SI5351_PLL_FIXED, SI5351_PLLA);           // Use fixed PLL multiplier
  delay(5);
  beacon.set_freq(target_freq, SI5351_CLK0);               // Output carrier on CLK0
  delay(5);
}


// ═════════════════════════════════════════════════════════════════════════════
// WEB PAGES (chunked HTTP transfer)
// ═════════════════════════════════════════════════════════════════════════════
/**
 * @brief Send one of several HTML pages using HTTP chunked transfer encoding.
 *
 * Chunked transfer avoids buffering the entire page in RAM (which would
 * quickly exhaust the ESP8266's heap). Each call to server.sendContent()
 * flushes one small chunk to the TCP socket.
 *
 * Page index:
 *   0 — Status page   (default route "/")
 *   1 — Setup page    ("/setup")
 *   2 — Settings applied confirmation
 *   3 — Wrong password error
 *   4 — (Reserved — was thermostat page)
 *   5 — (Reserved — was data charts page)
 *   6 — (Reserved — was registration page)
 *
 * @param textNumber Index of the page to send (see above)
 */
void SendHTMLchunked(uint8_t textNumber) {
  String ptr = "";

  // Disable browser caching so the status page always shows current values
  server.sendHeader("Cache-Control", "no-cache, no-store, must-revalidate");
  server.sendHeader("Pragma", "no-cache");
  server.sendHeader("Expires", "-1");
  server.setContentLength(CONTENT_LENGTH_UNKNOWN);
  server.send(200, "text/html", "");

  // ── Common HTML head ────────────────────────────────────────────────────
  server.sendContent(F("<!DOCTYPE html><html><head>"
                       "<meta name=\"viewport\" content=\"width=device-width, initial-scale=0.5\">"
                       "<title>CWbeacon</title>"));
  server.sendContent(F("<style>"
                       "form {margin: 0 auto; width: 600px; padding: 1em; border: 1px solid #CCC; border-radius: 1em;}"
                       "form div + div {margin-top: 1em;}"
                       "label {display: inline-block; width: 140px; text-align: right; padding-right:5px;}"
                       ".wide {display: inline-block; width: 220px; text-align: right; padding-right:5px;}"
                       "input, textarea {font: 1em sans-serif; width: 240px; box-sizing: border-box; border: 1px solid #999;}"
                       "input, canvas {vertical-align: bottom;}"
                       "input:focus, textarea:focus {border-color: #000;}"
                       ".small {width: 60px; type=\"number\"; maxlength=\"3\"; min=\"0\"; max=\"255\";}"
                       ".setp {width: 100px; type=\"number\"; maxlength=\"3\"; min=\"-40\"; max=\"85\";}"
                       "textarea {vertical-align: top; height: 5em;}"
                       "button {margin: 1em;}"
                       ".button {background-color: "));
  server.sendContent(bgcolor);
  server.sendContent(F("; color:white;text-align: center;border-radius: .5em;}"
                       "</style></head>"
                       "<body bgcolor=\""));
  server.sendContent(bgcolor);
  server.sendContent(F("\"><center>"
                       "<div class=\"container text-center\" style=\"background-color:white; width: 660px;"
                       " border-radius: 10px; border-color: rgb(14, 99, 174); border-width: medium; border-style: solid;\">"));

  // ── Page-specific content ────────────────────────────────────────────────
  switch (textNumber)
  {
    // ── Page 0: Status page ────────────────────────────────────────────────
    case 0:
      {
        server.sendContent(F("<h1>Status of "));
        server.sendContent(sysName);
        // Time and date line from the NTP client
        ptr = "</h1><form action=\"/\" method=\"post\"><p>" +
              String(daysOfTheWeek[timeClient.getDay()]) + " " +
              timeClient.getFormattedTime() + " UTC+" +
              String(utcOffsetInSeconds / 3600) + "</p>";
        server.sendContent(ptr);

        // Wi-Fi RSSI horizontal bar rendered on an HTML5 canvas element.
        // The bar length is mapped from the RSSI range [-100 dBm … -40 dBm]
        // using a red-to-green gradient: 3 pixels per dBm, offset by +40.
        server.sendContent(F("<div><label for=\"rssi\">WiFi RSSI dBm </label>"
                             "<canvas id=\"rssi\" width=\"240\" height=\"20\" style=\"border:1px solid #999;\">"
                             "HTML5 canvas not supported!</canvas>"));
        server.sendContent(F("<script>var c=document.getElementById(\"rssi\"); var ctx=c.getContext(\"2d\");"));
        server.sendContent(F("var grd=ctx.createLinearGradient(0,0,180,0); "
                             "grd.addColorStop(0,\"red\"); grd.addColorStop(1,\"lime\");"));
        server.sendContent(F("ctx.font=\"1em sans-serif\"; ctx.textAlign=\"right\"; ctx.fillText(\""));
        server.sendContent(String(rssi));
        server.sendContent(F("\",230,16); ctx.fillStyle=grd; ctx.fillRect(0,0,"));
        server.sendContent(String(((rssi + 40) * 3) + 180)); // Bar width (px)
        server.sendContent(F(",20);</script></div>"));

        // Beacon status fields (read-only)
        server.sendContent(F("<div><label for=\"qrg\">Beacon QRG Hz</label>"
                             "<input type=\"text\" name=\"qrg\" readonly value=\""));
        server.sendContent(qrg);
        server.sendContent(F("\"></div>"));

        server.sendContent(F("<div><label for=\"wpm\">Beacon WPM</label>"
                             "<input type=\"text\" name=\"wpm\" readonly value=\""));
        server.sendContent(String(wpms[speedIndex]));
        server.sendContent(F("\"></div>"));

        server.sendContent(F("<div><label for=\"qtc\">Beacon QTC</label>"
                             "<input type=\"text\" name=\"qtc\" readonly value=\""));
        server.sendContent(cw_message);
        server.sendContent(F("\"></div>"));

        // Beacon enable/disable checkbox (read-only on the status page)
        server.sendContent(F("<div><label for=\"bea_ena\">Beacon enable</label>"
                             "<input type=\"checkbox\" id=\"bea_ena\" name=\"bea_ena\" readonly value=\"1\" "));
        server.sendContent(BeaconON ? F("checked></div>") : F("></div>"));

        // Uptime display
        server.sendContent(F("<div><label for=\"uptime\">Uptime dd:hh:mm:ss </label>"
                             "<input type=\"text\" name=\"uptime\" readonly value=\""));
        unsigned long uptime      = millis() / 1000;
        unsigned char uptimeDays    = uptime / 86400;
        unsigned char uptimeHours   = (uptime % 86400) / 3600;
        unsigned char uptimeMinutes = (uptime % 3600) / 60;
        unsigned char uptimeSeconds = uptime % 60;
        ptr = String(uptimeDays)    + ":" +
              String(uptimeHours)   + ":" +
              String(uptimeMinutes) + ":" +
              String(uptimeSeconds);
        server.sendContent(ptr);
        server.sendContent(F("\"></div>"
                             "<div>"
                             "<button class=\"button\" type=\"button\" onclick=\"window.location.href='/setup';\">SETUP</button>"
                             "<button class=\"button\" type=\"submit\">REFRESH</button>"
                             "</div></form>"));
      }
      break;

    // ── Page 1: Setup / configuration page ────────────────────────────────
    case 1:
      {
        // System name and Wi-Fi credentials
        server.sendContent(F("<h1>Setup page</h1><br>"
                             "<form action=\"/applysettings\" method=\"post\">"
                             "<div><label for=\"name\">System Name</label>"
                             "<input type=\"text\" id=\"sysname\" name=\"system_name\" "
                             "pattern=\"[a-zA-Z0-9.\\-]{3,16}\" value=\""));
        server.sendContent(sysName);
        server.sendContent(F("\"></div>"
                             "<div><label for=\"wifi_ssid\">WiFi SSID</label>"
                             "<input type=\"text\" id=\"wifissid\" name=\"wifi_ssid\" maxlength=\"32\" value=\""));
        server.sendContent(wifissid);
        server.sendContent(F("\"></div>"
                             "<div><label for=\"wifi_pwd\">WiFi PASSWORD</label>"
                             "<input type=\"password\" id=\"wifipwd\" name=\"wifi_pwd\" maxlength=\"32\" value=\""));
        if (wifipwd.isEmpty()) {
          server.sendContent(F("\"></div>"
                               "<div><label for=\"staip0\">Static IP</label>"
                               "<input class=\"small\" id=\"staip0\" name=\"staip_0\" value=\""));
        }
        else {
          server.sendContent(wifipwd);
          server.sendContent(F("\"></div>"
                               "<div><label for=\"staip0\">Static IP</label>"
                               "<input class=\"small\" id=\"staip0\" name=\"staip_0\" value=\""));
        }

        // Static IP, netmask, gateway, and DNS fields (quad-octet inputs)
        server.sendContent(String(local_IP[0]));
        server.sendContent(F("\"><input class=\"small\" id=\"staip1\" name=\"staip_1\" value=\""));
        server.sendContent(String(local_IP[1]));
        server.sendContent(F("\"><input class=\"small\" id=\"staip2\" name=\"staip_2\" value=\""));
        server.sendContent(String(local_IP[2]));
        server.sendContent(F("\"><input class=\"small\" id=\"staip3\" name=\"staip_3\" value=\""));
        server.sendContent(String(local_IP[3]));
        server.sendContent(F("\"></div><div><label for=\"netm0\">Netmask</label>"
                             "<input class=\"small\" id=\"netm0\" name=\"netm_0\" value=\""));
        server.sendContent(String(subnet[0]));
        server.sendContent(F("\"><input class=\"small\" id=\"netm1\" name=\"netm_1\" value=\""));
        server.sendContent(String(subnet[1]));
        server.sendContent(F("\"><input class=\"small\" id=\"netm2\" name=\"netm_2\" value=\""));
        server.sendContent(String(subnet[2]));
        server.sendContent(F("\"><input class=\"small\" id=\"netm3\" name=\"netm_3\" value=\""));
        server.sendContent(String(subnet[3]));
        server.sendContent(F("\"></div><div><label for=\"defg0\">Default GW</label>"
                             "<input class=\"small\" id=\"defg0\" name=\"defg_0\" value=\""));
        server.sendContent(String(gateway[0]));
        server.sendContent(F("\"><input class=\"small\" id=\"defg1\" name=\"defg_1\" value=\""));
        server.sendContent(String(gateway[1]));
        server.sendContent(F("\"><input class=\"small\" id=\"defg2\" name=\"defg_2\" value=\""));
        server.sendContent(String(gateway[2]));
        server.sendContent(F("\"><input class=\"small\" id=\"defg3\" name=\"defg_3\" value=\""));
        server.sendContent(String(gateway[3]));
        server.sendContent(F("\"></div><div><label for=\"dns00\">Primary DNS</label>"
                             "<input class=\"small\" id=\"dns00\" name=\"dns0_0\" value=\""));
        server.sendContent(String(primaryDNS[0]));
        server.sendContent(F("\"><input class=\"small\" id=\"dns01\" name=\"dns0_1\" value=\""));
        server.sendContent(String(primaryDNS[1]));
        server.sendContent(F("\"><input class=\"small\" id=\"dns02\" name=\"dns0_2\" value=\""));
        server.sendContent(String(primaryDNS[2]));
        server.sendContent(F("\"><input class=\"small\" id=\"dns03\" name=\"dns0_3\" value=\""));
        server.sendContent(String(primaryDNS[3]));
        server.sendContent(F("\"></div><div><label for=\"dns10\">Secondary DNS</label>"
                             "<input class=\"small\" id=\"dns10\" name=\"dns1_0\" value=\""));
        server.sendContent(String(secondaryDNS[0]));
        server.sendContent(F("\"><input class=\"small\" id=\"dns11\" name=\"dns1_1\" value=\""));
        server.sendContent(String(secondaryDNS[1]));
        server.sendContent(F("\"><input class=\"small\" id=\"dns12\" name=\"dns1_2\" value=\""));
        server.sendContent(String(secondaryDNS[2]));
        server.sendContent(F("\"><input class=\"small\" id=\"dns13\" name=\"dns1_3\" value=\""));
        server.sendContent(String(secondaryDNS[3]));
        server.sendContent(F("\"></div>"));

        // Telegram bot enable checkbox and token
        server.sendContent(F("<div><label for=\"bot_ena\">TG bot ENABLE</label>"
                             "<input type=\"checkbox\" id=\"bot_ena\" name=\"bot_ena\" value=\"1\" "));
        server.sendContent(TGbotEnable ? F("checked></div>") : F("></div>"));
        server.sendContent(F("<div><label for=\"bottoken\">TG Bot token </label>"
                             "<input type=\"text\" id=\"bottoken\" name=\"bot_token\" maxlength=\"46\" value=\""));
        server.sendContent(token);

        // Telegram authorized user IDs (displayed as decimal; converted from uint64_t)
        server.sendContent(F("\"></div><div><label for=\"userid0\">Admin User ID</label>"
                             "<input type=\"text\" id=\"userid0\" name=\"user_id0\" maxlength=\"20\" value=\""));
        ptr = u64ToString(userid[0]);
        if (ptr.isEmpty()) ptr = "0";
        server.sendContent(ptr);
        server.sendContent(F("\"></div><div><label for=\"userid1\">Allowed User 1 ID</label>"
                             "<input type=\"text\" id=\"userid1\" name=\"user_id1\" maxlength=\"20\" value=\""));
        ptr = u64ToString(userid[1]);
        if (ptr.isEmpty()) ptr = "0";
        server.sendContent(ptr);
        server.sendContent(F("\"></div><div><label for=\"userid2\">Allowed User 2 ID</label>"
                             "<input type=\"text\" id=\"userid2\" name=\"user_id2\" maxlength=\"20\" value=\""));
        ptr = u64ToString(userid[2]);
        if (ptr.isEmpty()) ptr = "0";
        server.sendContent(ptr);
        server.sendContent(F("\"></div><div><label for=\"userid3\">Allowed User 3 ID</label>"
                             "<input type=\"text\" id=\"userid3\" name=\"user_id3\" maxlength=\"20\" value=\""));
        ptr = u64ToString(userid[3]);
        if (ptr.isEmpty()) ptr = "0";
        server.sendContent(ptr);

        // MAC address (read-only, informational)
        server.sendContent(F("\"></div><div><label for=\"macadr\">MAC address</label>"
                             "<input type=\"text\" id=\"macadr\" name=\"mac_adr\" readonly value=\""));
        server.sendContent(WiFi.macAddress());

        // Beacon parameters
        server.sendContent(F("\"></div><div><label for=\"getqrg\">Beacon QRG Hz</label>"
                             "<input type=\"text\" id=\"getqrg\" name=\"get_qrg\" maxlength=\"32\" value=\""));
        server.sendContent(qrg);
        server.sendContent(F("\"></div><div><label for=\"getcal\">QRG cal. factor</label>"
                             "<input type=\"text\" id=\"getcal\" name=\"get_cal\" maxlength=\"4\" value=\""));
        server.sendContent(String(cal_factor));
        server.sendContent(F("\"></div><div><label for=\"getmes\">Beacon QTC</label>"
                             "<input type=\"text\" id=\"getmes\" name=\"get_mes\" maxlength=\"32\" value=\""));
        server.sendContent(message);
        server.sendContent(F("\"></div><div><label for=\"getqrz\">Beacon QRZ</label>"
                             "<input type=\"text\" id=\"getqrz\" name=\"get_qrz\" maxlength=\"24\" value=\""));
        server.sendContent(qrz);
        server.sendContent(F("\"></div><div><label for=\"getwpm\">Beacon WPM</label>"
                             "<input type=\"text\" id=\"getwpm\" name=\"get_wpm\" maxlength=\"24\" value=\""));
        server.sendContent(String(wpms[0]));
        server.sendContent(F("\"></div><div><label for=\"bgcolor\">Background color</label>"
                             "<input type=\"text\" id=\"bgcolor\" name=\"bg_col\" maxlength=\"7\" value=\""));
        server.sendContent(bgcolor);
        server.sendContent(F("\"></div>"));

        // Password change fields (both must match; min 8 characters)
        server.sendContent(F("<div><label for=\"getpwd1\">New password </label>"
                             "<input type=\"text\" id=\"getpwd1\" name=\"get_pwd1\" maxlength=\"16\"></div>"
                             "<div><label for=\"getpwd2\">Repeat new password </label>"
                             "<input type=\"text\" id=\"getpwd2\" name=\"get_pwd2\" maxlength=\"16\"></div>"));
        server.sendContent(F("<div><label for=\"admpwd\">Admin Password </label>"
                             "<input type=\"password\" id=\"admpwd\" name=\"adm_pwd\" maxlength=\"16\"></div>"
                             "<div>"
                             "<button class=\"button\" type=\"button\" onclick=\"window.location.href='/';\">"
                             "BACK</button>"
                             "<button class=\"button\" type=\"submit\">APPLY SETTINGS</button>"
                             "</div></form>"));
      }
      break;

    // ── Page 2: Settings applied confirmation ──────────────────────────────
    case 2:
      {
        server.sendContent(F("<h1>Settings applied!</h1><br>"
                             "<p>All the settings have been correctly applied.</p>"
                             "<p>Please restart the system to make them effective.</p>"));
        server.sendContent(F("<form action=\"/restart\" method=\"post\">"
                             "<input type=\"hidden\" id=\"resreq\" name=\"res_req\" value=\"1978\">"
                             "<div><button class=\"button\" type=\"submit\">Restart the system</button></div>"
                             "</form>"));
      }
      break;

    // ── Page 3: Wrong admin password error ────────────────────────────────
    case 3:
      {
        server.sendContent(F("<h1>Wrong password!</h1><br>"
                             "<p>The admin password you entered was wrong.</p>"
                             "<p>Please go back and try again.</p>"));
        server.sendContent(F("<form action=\"/setup\" method=\"post\">"
                             "<div><button class=\"button\" type=\"submit\">Go back to setup</button></div>"
                             "</form>"));
      }
      break;

    // ── Pages 4–6: Reserved (unused) ──────────────────────────────────────
    case 4:
    case 5:
    case 6:
    default:
      break;
  }

  // ── Common HTML footer ───────────────────────────────────────────────────
  server.sendContent(F("<br><p>"));
  server.sendContent(firmwareRev);
  server.sendContent(F("</p><p>Made by IoT Lab @ IIS Cassata Gattapone, Gubbio, Italy<br>"
                       "<a href=https://doctoriot.wordpress.com target=\"_new\">Doctor IoT</a>"
                       "</p></div></center></body></html>"));
  server.sendContent(F(""));  // Empty chunk signals end-of-response to the browser
  server.client().stop();
}


// ═════════════════════════════════════════════════════════════════════════════
// HTTP ROUTE HANDLERS
// ═════════════════════════════════════════════════════════════════════════════

/**
 * @brief Handle POST to /applysettings — validate the admin password and
 *        save all form fields to EEPROM if authentication succeeds.
 */
void handle_applysettings() {
  // Parse all form fields from the HTTP POST body
  sysname       = server.arg("system_name");
  wifissid      = server.arg("wifi_ssid");
  wifipwd       = server.arg("wifi_pwd");
  String ip0    = server.arg("staip_0");
  String ip1    = server.arg("staip_1");
  String ip2    = server.arg("staip_2");
  String ip3    = server.arg("staip_3");
  String nm0    = server.arg("netm_0");
  String nm1    = server.arg("netm_1");
  String nm2    = server.arg("netm_2");
  String nm3    = server.arg("netm_3");
  String dg0    = server.arg("defg_0");
  String dg1    = server.arg("defg_1");
  String dg2    = server.arg("defg_2");
  String dg3    = server.arg("defg_3");
  String dn00   = server.arg("dns0_0");
  String dn01   = server.arg("dns0_1");
  String dn02   = server.arg("dns0_2");
  String dn03   = server.arg("dns0_3");
  String dn10   = server.arg("dns1_0");
  String dn11   = server.arg("dns1_1");
  String dn12   = server.arg("dns1_2");
  String dn13   = server.arg("dns1_3");
  String botena = server.arg("bot_ena");
  String temp_token = server.arg("bot_token");
  String userid0    = server.arg("user_id0");
  String userid1    = server.arg("user_id1");
  String userid2    = server.arg("user_id2");
  String userid3    = server.arg("user_id3");
  String ppmthr     = server.arg("ppm_thr");   // Reserved
  String toff       = server.arg("t_off");      // Reserved
  String httpsena   = server.arg("https_ena");  // Reserved

  // Validate and parse the WPM field
  String wpm    = server.arg("get_wpm");
  float  temp   = wpm.toFloat();
  if (temp > 0 && temp <= 30) {
    wpms[0] = temp;
  }

  message = server.arg("get_mes");
  qrz     = server.arg("get_qrz");
  qrg     = server.arg("get_qrg");

  // Validate the calibration factor (must be within ±10000 Hz)
  String fcal   = server.arg("get_cal");
  long   temp1  = fcal.toInt();
  if (-10000 < temp1 && temp1 < 10000) {
    cal_factor = temp1;
  }
  else {
    fcal = String(cal_factor);  // Out-of-range: keep the current value
  }
  cal_factor = fcal.toInt();

  bgcolor  = server.arg("bg_col");
  String getpwd1 = server.arg("get_pwd1");
  String getpwd2 = server.arg("get_pwd2");
  admpwd         = server.arg("adm_pwd");

  // In admin mode, echo all received parameters to the serial monitor for debugging
  if (ADMIN) {
    Serial.print("Sysname from web: ");       Serial.println(sysname);
    Serial.print("WiFi ssid from web: ");     Serial.println(wifissid);
    Serial.print("WiFi pwd from web: ");      Serial.println(wifipwd);
    Serial.print("Static IP from web: ");     Serial.println(ip0 + " " + ip1 + " " + ip2 + " " + ip3);
    Serial.print("Netmask from web: ");       Serial.println(nm0 + " " + nm1 + " " + nm2 + " " + nm3);
    Serial.print("Default GW from web: ");    Serial.println(dg0 + " " + dg1 + " " + dg2 + " " + dg3);
    Serial.print("Primary DNS from web: ");   Serial.println(dn00 + " " + dn01 + " " + dn02 + " " + dn03);
    Serial.print("Secondary DNS from web: "); Serial.println(dn10 + " " + dn11 + " " + dn12 + " " + dn13);
    Serial.print("TG bot enable from web: "); Serial.println(botena);
    Serial.print("TG token from web: ");      Serial.println(temp_token);
    Serial.print("User id0 from web: ");      Serial.println(userid0);
    Serial.print("User id1 from web: ");      Serial.println(userid1);
    Serial.print("User id2 from web: ");      Serial.println(userid2);
    Serial.print("User id3 from web: ");      Serial.println(userid3);
    Serial.print("Cal. Factor from web: ");   Serial.println(fcal);
    Serial.print("Message from web: ");       Serial.println(message);
    Serial.print("QRZ from web: ");           Serial.println(qrz);
    Serial.print("QRG from web: ");           Serial.println(qrg);
    Serial.print("BG color from web: ");      Serial.println(bgcolor);
    Serial.print("New pwd1 from the web: ");  Serial.println(getpwd1);
    Serial.print("New pwd2 from the web: ");  Serial.println(getpwd2);
    Serial.print("Admin pwd from web: ");     Serial.println(admpwd);
  }

  // ── Authentication and EEPROM save ──────────────────────────────────────
  if (admpwd == adminpwd) {
    // Correct admin password — persist all settings to EEPROM
    saveString2eeprom(sysname,    sysNameAdr,  sysNameLen);
    saveString2eeprom(wifissid,   APssidAdr,   APssidLen);
    saveString2eeprom(wifipwd,    APpwdAdr,    APpwdLen);

    // Static IP: each octet stored as a single byte
    saveByte2eeprom(ip0.toInt() & 0xFF, staticIpAdr);
    saveByte2eeprom(ip1.toInt() & 0xFF, staticIpAdr + 1);
    saveByte2eeprom(ip2.toInt() & 0xFF, staticIpAdr + 2);
    saveByte2eeprom(ip3.toInt() & 0xFF, staticIpAdr + 3);

    saveByte2eeprom(nm0.toInt() & 0xFF, netMaskAdr);
    saveByte2eeprom(nm1.toInt() & 0xFF, netMaskAdr + 1);
    saveByte2eeprom(nm2.toInt() & 0xFF, netMaskAdr + 2);
    saveByte2eeprom(nm3.toInt() & 0xFF, netMaskAdr + 3);

    saveByte2eeprom(dg0.toInt() & 0xFF, gatewayIpAdr);
    saveByte2eeprom(dg1.toInt() & 0xFF, gatewayIpAdr + 1);
    saveByte2eeprom(dg2.toInt() & 0xFF, gatewayIpAdr + 2);
    saveByte2eeprom(dg3.toInt() & 0xFF, gatewayIpAdr + 3);

    // sensorsEnableAdr byte: bit0 = Telegram bot enable
    char val = 0;
    if (botena == "1") val += 1;
    saveByte2eeprom(val, sensorsEnableAdr);

    saveByte2eeprom(dn00.toInt() & 0xFF, dnsIp0Adr);
    saveByte2eeprom(dn01.toInt() & 0xFF, dnsIp0Adr + 1);
    saveByte2eeprom(dn02.toInt() & 0xFF, dnsIp0Adr + 2);
    saveByte2eeprom(dn03.toInt() & 0xFF, dnsIp0Adr + 3);
    saveByte2eeprom(dn10.toInt() & 0xFF, dnsIp1Adr);
    saveByte2eeprom(dn11.toInt() & 0xFF, dnsIp1Adr + 1);
    saveByte2eeprom(dn12.toInt() & 0xFF, dnsIp1Adr + 2);
    saveByte2eeprom(dn13.toInt() & 0xFF, dnsIp1Adr + 3);

    // Telegram user IDs are stored as 8-byte big-endian uint64_t values
    uint64_t tempval;
    tempval = Str2u64(userid0); saveU64eeprom(tempval, user0Adr);
    tempval = Str2u64(userid1); saveU64eeprom(tempval, user1Adr);
    tempval = Str2u64(userid2); saveU64eeprom(tempval, user2Adr);
    tempval = Str2u64(userid3); saveU64eeprom(tempval, user3Adr);

    saveString2eeprom(temp_token, tokenAdr,   tokenLen);
    saveString2eeprom(fcal,       fcalAdr,    fcalLen);
    saveString2eeprom(message,    messageAdr, messageLen);
    saveString2eeprom(qrz,        qrzAdr,     qrzLen);
    saveString2eeprom(qrg,        qrgAdr,     qrgLen);
    saveString2eeprom(wpm,        wpmAdr,     wpmLen);
    saveString2eeprom(bgcolor,    bgcolorAdr, bgcolorLen);

    // Change the admin password if both new-password fields match and are ≥8 chars
    if (getpwd1 == getpwd2 && getpwd1.length() > 7) {
      saveString2eeprom(getpwd1, admPwdAdr, admPwdLen);
      EEPROM.begin(EEmemLen);
      EEPROM.write(pwdChangedAdr, '1');  // Mark password as changed
      EEPROM.end();
    }

    SendHTMLchunked(2);  // "Settings applied" confirmation page
  }
  else {
    SendHTMLchunked(3);  // "Wrong password" error page
  }
}

/** @brief Serve the status page on the root route "/" */
void handle_OnConnect() {
  SendHTMLchunked(0);
}

/**
 * @brief Handle POST to /restart — verify the hidden token and reboot.
 *
 * The hidden form field "res_req" must equal "1978" (set by page 2).
 * This prevents accidental reboot by a direct GET to /restart.
 */
void handle_restart() {
  String resreq = server.arg("res_req");
  if (resreq == "1978") {
    server.sendHeader("Cache-Control", "no-cache, no-store, must-revalidate");
    server.sendHeader("Pragma", "no-cache");
    server.sendHeader("Expires", "-1");
    server.setContentLength(CONTENT_LENGTH_UNKNOWN);
    server.send(200, "text/html", "");
    // Auto-redirect to the root page after 5 seconds (by which time the reboot is done)
    server.sendContent(F("<!DOCTYPE html><html><head>"
                         "<meta http-equiv=\"refresh\" content=\"5; url='/'\" />"
                         "</head><body><p>Wait while rebooting..</p></body></html>"));
    server.sendContent(F(""));
    server.client().stop();
    ESP.restart();
  }
  else {
    // Invalid token — reject the request and redirect to the home page
    server.sendHeader("Cache-Control", "no-cache, no-store, must-revalidate");
    server.sendHeader("Pragma", "no-cache");
    server.sendHeader("Expires", "-1");
    server.setContentLength(CONTENT_LENGTH_UNKNOWN);
    server.send(200, "text/html", "");
    server.sendContent(F("<!DOCTYPE html><html><head>"
                         "<meta http-equiv=\"refresh\" content=\"3; url='/'\" />"
                         "</head><body><p>This request is not allowed!</p></body></html>"));
    server.sendContent(F(""));
    server.client().stop();
  }
}

/** @brief Serve the setup / configuration page on "/setup" */
void handle_setup() {
  SendHTMLchunked(1);
}

/** @brief Serve the status page for any URL not matched by a registered route */
void handle_NotFound() {
  SendHTMLchunked(0);
}


// ═════════════════════════════════════════════════════════════════════════════
// WI-FI CONNECTION
// ═════════════════════════════════════════════════════════════════════════════
/**
 * @brief Initialize Wi-Fi and start all network services.
 *
 * Attempts to connect to the configured Wi-Fi network (STA mode) for up to
 * ~10 seconds. If the connection fails, the device creates its own Access
 * Point (SSID: CWbeacon-AP) so a browser can still reach the configuration
 * page at http://192.168.4.1/ without an external network.
 *
 * After Wi-Fi is configured, this function:
 *   - Registers all HTTP server routes
 *   - Starts the HTTP server on port 80
 *   - Enables the OTA firmware update endpoint at /update (admin-password-protected)
 */
void wifiConnection(void) {
  // Determine whether to use a static IP or DHCP.
  // All-ones (255.255.255.255) or all-zeros are treated as "use DHCP".
  if (!((local_IP[0] == 255 && local_IP[1] == 255 &&
         local_IP[2] == 255 && local_IP[3] == 255) || (local_IP[0] == 0))) {
    // Static IP configured — apply before connecting
    if (!WiFi.config(local_IP, gateway, subnet, primaryDNS, secondaryDNS)) {
      Serial.println("STA Failed to configure");
    }
  }

  Serial.print("Connecting to ");
  Serial.println(wifissid);

  // Connect with or without a password depending on the network type
  if (wifipwd.isEmpty()) {
    Serial.println("WiFi.begin(wifissid);");
    WiFi.begin(wifissid);
  }
  else {
    Serial.println("WiFi.begin(wifissid, wifipwd);");
    WiFi.begin(wifissid, wifipwd);
  }

  // Poll for connection; timeout after ~10.2 seconds
  unsigned long startTime = millis();
  while (WiFi.status() != WL_CONNECTED) {
    delay(500);
    Serial.print(".");
    if ((millis() - startTime) > 10200) {
      break;
    }
  }

  if (WiFi.status() == WL_CONNECTED) {
    // STA mode — successfully joined the network
    APmodeON = 0;
    Serial.println(" connected!");
    Serial.print("Local IP address: "); Serial.println(WiFi.localIP());
    Serial.print("MAC address: ");      Serial.println(WiFi.macAddress());
    WiFi.printDiag(Serial);
  }
  else {
    // STA connection failed — fall back to AP mode
    if (APmodeON == 0) {
      Serial.println("WiFi connection failed, switching to AP mode!");
      WiFi.softAP(APssid, APpwd);
      IPAddress IP = WiFi.softAPIP();
      Serial.print("AP IP address: "); Serial.println(IP);
      Serial.println(WiFi.localIP());
      APmodeON = 1;
    }
    else {
      Serial.println("AP mode ON!");
    }
  }

  // ── Register HTTP routes ────────────────────────────────────────────────
  server.on("/",              handle_OnConnect);
  server.on("/setup",         handle_setup);
  server.on("/applysettings", handle_applysettings);
  server.on("/restart",       handle_restart);
  server.onNotFound(handle_NotFound);
  server.begin();
  Serial.println("HTTP server started");

  // ── OTA firmware update server ──────────────────────────────────────────
  // Accessible at http://<device-ip>/update; protected by the admin password
  String tempStr = adminpwd;
  const char* updatePWD = tempStr.c_str();
  httpUpdater.setup(&server, "/update", "admin", updatePWD);
  Serial.print("HTTP Update Server ready! Open http://");
  if (APmodeON)
    Serial.print(WiFi.softAPIP());
  else
    Serial.print(WiFi.localIP());
  Serial.println("/update in your browser");
}


// ═════════════════════════════════════════════════════════════════════════════
// CRC-16 (FLETCHER-16 VARIANT)
// ═════════════════════════════════════════════════════════════════════════════
/**
 * @brief Compute a Fletcher-16 variant checksum over a byte array.
 *
 * Standard Fletcher-16 uses modulo 65535; this implementation uses modulo 255
 * for both accumulators, which produces a different (but still valid) 16-bit
 * output in the range [0x0000, 0xFEFE].
 *
 * The checksum is used to authenticate each CW transmission:
 *   input  = "yymmddhhmm" + "25041874"  (UTC timestamp + Marconi's birthday salt)
 *   output = 4 hex characters appended to the beacon message
 *
 * Any receiver that knows the salt and the UTC time can recompute the checksum
 * and verify that the transmission is genuine and time-stamped correctly.
 *
 * @param data   Pointer to the input byte array
 * @param length Number of bytes to process
 * @return       16-bit checksum: high byte = sum2, low byte = sum1
 */
uint16_t checksumCalculator(uint8_t * data, uint16_t length) {
  uint16_t curr_crc = 0x0000;
  uint8_t sum1 = (uint8_t) curr_crc;
  uint8_t sum2 = (uint8_t)(curr_crc >> 8);
  for (int index = 0; index < length; index++) {
    sum1 = (sum1 + data[index]) % 255;
    sum2 = (sum2 + sum1) % 255;
  }
  return (sum2 << 8) | sum1;
}


// ═════════════════════════════════════════════════════════════════════════════
// EEPROM HELPER FUNCTIONS
// ═════════════════════════════════════════════════════════════════════════════

/**
 * @brief Write a 64-bit unsigned integer to EEPROM in big-endian byte order.
 *
 * Stores 8 bytes starting at startAdr: most-significant byte first.
 * Big-endian order is preserved when reading back with simple byte-shift
 * reconstruction in varPreset().
 *
 * @param val      Value to write
 * @param startAdr Starting EEPROM address (must have 8 bytes available)
 */
void saveU64eeprom(uint64_t val, unsigned int startAdr)
{
  EEPROM.begin(EEmemLen);
  for (unsigned char i = 0; i < 8; i++) {
    unsigned char val0 = val & 0x00000000000000ffULL;
    EEPROM.write(startAdr + 7 - i, val0);  // Write least-significant byte last (big-endian)
    val = val >> 8;
  }
  EEPROM.end();
}

/**
 * @brief Write a single byte to EEPROM.
 *
 * @param val     Byte value to write
 * @param address EEPROM address to write to
 */
void saveByte2eeprom(unsigned char val, int address)
{
  EEPROM.begin(EEmemLen);
  EEPROM.write(address, val);
  EEPROM.end();
}

/**
 * @brief Write a null-terminated String to a fixed-length EEPROM field.
 *
 * Writes the string's characters up to the null terminator, then pads
 * the remaining bytes in the field with null (0x00). This ensures that
 * a shorter replacement value never leaves stale characters from a
 * previous longer value.
 *
 * @param str2Write String to store
 * @param startAdr  Starting EEPROM address
 * @param strLen    Total field length in bytes (including padding)
 */
void saveString2eeprom(String str2Write, int startAdr, int strLen)
{
  int i = 0;
  EEPROM.begin(EEmemLen);
  // Write string characters until the null terminator
  while (str2Write[i] != 0) {
    EEPROM.write(startAdr + i, str2Write[i]);
    i++;
  }
  // Zero-fill the remainder of the field
  while (i < strLen) {
    EEPROM.write(startAdr + i, 0);
    i++;
  }
  EEPROM.end();
}


// ═════════════════════════════════════════════════════════════════════════════
// STARTUP VARIABLE PRELOAD FROM EEPROM
// ═════════════════════════════════════════════════════════════════════════════
/**
 * @brief Read all configuration from EEPROM into RAM variables at boot.
 *
 * Reads the full 512-byte EEPROM image into a local buffer once, then
 * extracts each parameter from its fixed address range. This avoids
 * repeated EEPROM.begin() / EEPROM.end() calls during parsing.
 *
 * Parameters loaded: admin password, feature enable flags, Wi-Fi SSID and
 * password, background color, Telegram token, static IP / netmask / gateway /
 * DNS, system name, beacon message, call sign, carrier frequency, authorized
 * Telegram user IDs, calibration factor, WPM, and GET period.
 */
void varPreset(void)
{
  char    EEmemData[EEmemLen];   // Full EEPROM image
  int     i;
  char    tempC;
  String  st;
  st.reserve(48);
  bool    empty = true;

  // ── Bulk read ───────────────────────────────────────────────────────────
  EEPROM.begin(EEmemLen);
  for (int i = 0; i < EEmemLen; i++) {
    EEmemData[i] = char(EEPROM.read(i));
  }
  EEPROM.end();

  // ── Password-changed flag ───────────────────────────────────────────────
  // '1' means the password has been changed via the web UI; any other value
  // causes varPreset() to revert to the factory default "12345678".
  pwdChanged = EEmemData[pwdChangedAdr];

  // ── Admin password ──────────────────────────────────────────────────────
  empty = true;
  st    = "";
  i     = 0;
  while (i < admPwdLen) {
    tempC = EEmemData[admPwdAdr + i];
    if (tempC == '\0') {
      if (i > 0) empty = false;
      i = admPwdLen;
    }
    else {
      st += tempC;
    }
    i++;
  }
  // Use the stored password only if it has been deliberately set
  if (empty == true || pwdChanged != '1') {
    adminpwd = "12345678";   // Factory default
  }
  else {
    adminpwd = st;
  }
  Serial.print("Admin pwd: "); Serial.print(adminpwd); Serial.println(".");

  // ── Feature enable flags ────────────────────────────────────────────────
  // Byte at sensorsEnableAdr: bit0 = Telegram bot enable
  unsigned char Enables = EEmemData[sensorsEnableAdr];
  TGbotEnable = Enables & 0x01;

  // ── Wi-Fi SSID (stored network name, STA mode) ──────────────────────────
  i  = 0;
  st = "";
  while (i < APssidLen) {
    tempC = EEmemData[APssidAdr + i];
    if (tempC == '\0') { i = APssidLen; }
    else                { st += tempC; }
    i++;
  }
  wifissid = (st.length() > 0) ? st : "";
  Serial.print("AP SSID: "); Serial.print(wifissid); Serial.println(".");

  // ── Wi-Fi password ──────────────────────────────────────────────────────
  i  = 0;
  st = "";
  while (i < APpwdLen) {
    tempC = EEmemData[APpwdAdr + i];
    if (tempC == '\0') { i = APpwdLen; }
    else                { st += tempC; }
    i++;
  }
  wifipwd = (st.length() > 0) ? st : "";
  Serial.print("AP PWD: "); Serial.print(wifipwd); Serial.println(".");

  // ── HTML background color ───────────────────────────────────────────────
  // Must start with '#'; fall back to the default blue if missing or malformed
  empty = true;
  i     = 0;
  st    = "";
  while (i < bgcolorLen) {
    tempC = EEmemData[bgcolorAdr + i];
    if (tempC == '\0') {
      if (i > 0) empty = false;
      i = bgcolorLen;
    }
    else {
      st += tempC;
    }
    i++;
    if (i == bgcolorLen) empty = false;
  }
  Serial.print("BG color: ");
  if (empty || st.charAt(0) != '#') {
    bgcolor = "#1e73be";   // Default: DockerBlue
  }
  else {
    bgcolor = st;
  }
  Serial.print(bgcolor); Serial.println(".");

  // ── Telegram Bot token ──────────────────────────────────────────────────
  // The token field is read as-is (no null-termination check) because the
  // token always fills the full tokenLen bytes.
  i  = 0;
  st = "";
  while (i < tokenLen) {
    st += EEmemData[tokenAdr + i];
    i++;
  }
  token = (st.length() > 0) ? st : "";
  Serial.print("TG token: "); Serial.print(token); Serial.println(".");

  // ── Static IP configuration ─────────────────────────────────────────────
  // Each IPv4 address is stored as 4 consecutive bytes (one octet each).
  local_IP[0]     = EEmemData[staticIpAdr];
  local_IP[1]     = EEmemData[staticIpAdr + 1];
  local_IP[2]     = EEmemData[staticIpAdr + 2];
  local_IP[3]     = EEmemData[staticIpAdr + 3];
  subnet[0]       = EEmemData[netMaskAdr];
  subnet[1]       = EEmemData[netMaskAdr + 1];
  subnet[2]       = EEmemData[netMaskAdr + 2];
  subnet[3]       = EEmemData[netMaskAdr + 3];
  gateway[0]      = EEmemData[gatewayIpAdr];
  gateway[1]      = EEmemData[gatewayIpAdr + 1];
  gateway[2]      = EEmemData[gatewayIpAdr + 2];
  gateway[3]      = EEmemData[gatewayIpAdr + 3];
  primaryDNS[0]   = EEmemData[dnsIp0Adr];
  primaryDNS[1]   = EEmemData[dnsIp0Adr + 1];
  primaryDNS[2]   = EEmemData[dnsIp0Adr + 2];
  primaryDNS[3]   = EEmemData[dnsIp0Adr + 3];
  secondaryDNS[0] = EEmemData[dnsIp1Adr];
  secondaryDNS[1] = EEmemData[dnsIp1Adr + 1];
  secondaryDNS[2] = EEmemData[dnsIp1Adr + 2];
  secondaryDNS[3] = EEmemData[dnsIp1Adr + 3];

  // ── System name ─────────────────────────────────────────────────────────
  i  = 0;
  st = "";
  while (i < sysNameLen) {
    tempC = EEmemData[sysNameAdr + i];
    if (tempC == '\0') { i = sysNameLen; }
    else                { st += tempC; }
    i++;
  }
  sysName = (st.length() > 0) ? st : "";
  Serial.print("Name: "); Serial.print(sysName); Serial.println(".");

  // ── Beacon message (QTC payload) ────────────────────────────────────────
  empty = true;
  i     = 0;
  st    = "";
  while (i < messageLen) {
    tempC = EEmemData[messageAdr + i];
    if (tempC == '\0') {
      if (i > 0) empty = false;
      i = messageLen;
    }
    else {
      st += tempC;
    }
    i++;
    if (i == messageLen) empty = false;
  }
  message = empty ? "" : st;
  Serial.print("Beacon msg: "); Serial.print(message); Serial.println(".");

  // ── Call sign (QRZ) ─────────────────────────────────────────────────────
  empty = true;
  i     = 0;
  st    = "";
  while (i < qrzLen) {
    tempC = EEmemData[qrzAdr + i];
    if (tempC == '\0') {
      if (i > 0) empty = false;
      i = qrzLen;
    }
    else {
      st += tempC;
    }
    i++;
    if (i == qrzLen) empty = false;
  }
  qrz = empty ? "" : st;
  Serial.print("QRZ: "); Serial.print(qrz); Serial.println(".");

  // ── Carrier frequency string (QRG, in Hz as text) ───────────────────────
  empty = true;
  i     = 0;
  st    = "";
  while (i < qrgLen) {
    tempC = EEmemData[qrgAdr + i];
    if (tempC == '\0') {
      if (i > 0) empty = false;
      i = qrgLen;
    }
    else {
      st += tempC;
    }
    i++;
    if (i == qrgLen) empty = false;
  }
  qrg = empty ? "" : st;
  Serial.print("QRG: "); Serial.print(qrg); Serial.println(".");
  target_freq = Str2u64(qrg) * 100;  // Pre-compute centi-Hz value for the Si5351

  // ── Telegram authorized user IDs (big-endian uint64_t, 8 bytes each) ────
  // Reconstruction: read 8 bytes and shift-accumulate MSB first
  for (int u = 0; u < 4; u++) {
    unsigned int base = user0Adr + u * 8;
    userid[u] = EEmemData[base];
    for (int j = 1; j < 8; j++) {
      userid[u] = (userid[u] << 8) + (unsigned char)EEmemData[base + j];
    }
  }

  // ── Frequency calibration factor ────────────────────────────────────────
  {
    String fcal = "";
    i  = 0;
    st = "";
    while (i < fcalLen) {
      tempC = EEmemData[fcalAdr + i];
      if (tempC == '\0') { i = fcalLen; }
      else                { st += tempC; }
      i++;
    }
    fcal       = (st.length() > 0) ? st : "0";
    cal_factor = fcal.toInt();
    Serial.print("Cal. factor: "); Serial.print(fcal); Serial.println(".");
  }

  // ── Morse speed (WPM) ────────────────────────────────────────────────────
  {
    String wpm = "";
    i  = 0;
    st = "";
    while (i < wpmLen) {
      tempC = EEmemData[wpmAdr + i];
      if (tempC == '\0') { i = wpmLen; }
      else                { st += tempC; }
      i++;
    }
    wpm     = (st.length() > 0) ? st : "1";
    wpms[0] = wpm.toFloat();
    Serial.print("WPM: "); Serial.print(wpm); Serial.println(".");
  }

}



// ═════════════════════════════════════════════════════════════════════════════
// UTILITY FUNCTIONS
// ═════════════════════════════════════════════════════════════════════════════

/**
 * @brief Convert a uint64_t integer to its decimal String representation.
 *
 * The standard Arduino String(val) constructor does not support uint64_t
 * on the ESP8266; this function provides the conversion manually.
 *
 * @param value The 64-bit unsigned integer to convert
 * @return      String of decimal digits (e.g. "1234567890")
 */
String u64ToString(uint64_t value)
{
  // Use uint8_t (unsigned) for the index to avoid -Wchar-subscripts:
  // a signed 'char' index causes a warning because negative indices are undefined.
  uint8_t Ndigits = (value > 0) ? (uint8_t)(log10((double)value) + 1) : 1;
  char temp[Ndigits + 1];
  temp[Ndigits] = 0;  // Null terminator
  for (uint8_t i = Ndigits; i--; value /= 10) {
    temp[i] = '0' + (value % 10);
  }
  return String(temp);
}

/**
 * @brief Convert a decimal digit String to a uint64_t integer.
 *
 * Parses the string left-to-right using explicit power-of-10 multiplication.
 * This is needed because String.toInt() / atoi() return only 32-bit results.
 *
 * @param text String of decimal digits (e.g. "14096950")
 * @return     Parsed uint64_t value
 */
uint64_t Str2u64(String text)
{
  unsigned int len = text.length();
  uint64_t val = 0;
  for (unsigned int i = 0; i < len; i++) {
    uint64_t multiplier = 1;
    // Compute 10^(len-i-1)
    for (char j = 0; j < (len - i - 1); j++) {
      multiplier *= 10;
    }
    val += (uint64_t)(text[i] - '0') * multiplier;
  }
  return val;
}
